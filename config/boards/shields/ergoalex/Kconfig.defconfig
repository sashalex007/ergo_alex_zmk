## config/boards/shields/ergoalex/Kconfig.defconfig
```kconfig
if SHIELD_ERGOALEX_RIGHT

    config ZMK_KEYBOARD_NAME
        default "ergoalex"

    config ZMK_SPLIT_BLE_ROLE_CENTRAL
        default y

endif


if SHIELD_ERGOALEX_LEFT || SHIELD_ERGOALEX_RIGHT

    config ZMK_SPLIT
        default y

endif
```

## config/boards/shields/ergoalex/Kconfig.shield
```kconfig
config SHIELD_ERGOALEX_LEFT
    def_bool $(shields_list_contains,ergoalex_left)

config SHIELD_ERGOALEX_RIGHT
    def_bool $(shields_list_contains,ergoalex_right)
```
