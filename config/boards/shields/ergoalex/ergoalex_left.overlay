#include "ergoalex.dtsi" 

&kscan0 {
    row-gpios = <&gpio0 6  (GPIO_ACTIVE_HIGH | GPIO_PULL_DOWN)>,
                <&gpio0 8  (GPIO_ACTIVE_HIGH | GPIO_PULL_DOWN)>,
                <&gpio1 0  (GPIO_ACTIVE_HIGH | GPIO_PULL_DOWN)>,
                <&gpio0 11 (GPIO_ACTIVE_HIGH | GPIO_PULL_DOWN)>;

    col-gpios = <&gpio0 17 (GPIO_ACTIVE_HIGH)>,
                <&gpio1 6  (GPIO_ACTIVE_HIGH)>,
                <&gpio0 20 (GPIO_ACTIVE_HIGH)>,
                <&gpio0 22 (GPIO_ACTIVE_HIGH)>,
                <&gpio0 24 (GPIO_ACTIVE_HIGH)>;
};

    


